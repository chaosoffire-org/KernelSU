## kernel/Kconfig
```kconfig
menu "KernelSU"

config KSU
	tristate "KernelSU function support"
	depends on KPROBES && EXT4_FS
	default y
	help
	  Enable kernel-level root privileges on Android System.
	  Requires CONFIG_KPROBES for kernel hooking support.
	  Requires CONFIG_EXT4_FS for `ext4_unregister_sysfs`.
	  To compile as a module, choose M here: the
	  module will be called kernelsu.

config KSU_DEBUG
	bool "KernelSU debug mode"
	depends on KSU
	default n
	help
	  Enable KernelSU debug mode.

config KSU_DISABLE_MANAGER
	bool "Disable KernelSU manager integration"
	depends on KSU
	default n
	help
	  Disable manager APK detection and manager-specific handling.
	  Root will be used in place of manager-only functionality.

config KSU_DISABLE_POLICY
	bool "Disable KernelSU policy profiles"
	depends on KSU
	default n
	help
	  Disable per-app root/non-root profile customization.
	  Escalation will always use the default full root profile, and
	  non-root handling will follow the global umount policy only.

config KSU_X86_PATCH_SYSCALL_DISPATCHER
	bool "Dynamically patch x64's hardened syscall dispatcher to support syscall hooks"
	depends on KSU && X86_64
	default n
	help
	  Dynamically patch x64's hardened syscall dispatcher to support syscall hooks. This is a
	  replacement for a kernel source code patch, and is useful for x86_64 LKM mode.

config KSU_CVE_2026_98260_GUARD
	bool "Deny per-thread CPU timers (CVE-2026-98260)"
	depends on KSU
	default y
	help
	  Intercept timer_create(2) and refuse CLOCK_THREAD_CPUTIME_ID for every
	  process once KernelSU is loaded. The syscall entry is a clang-built C
	  function because arm64 kCFI checks indirect-call targets; the policy
	  is a clockid comparison that also covers encoded per-thread CPU clocks.
	  The loader runs before this module. Mitigation, not a kernel fix: a
	  per-thread timer armed before load is not removed.

config KSU_STEALTH
	bool "Hide KernelSU artifacts from non-KSU processes"
	depends on KSU
	default y
	help
	  Hide KernelSU paths from app uids (>= 10000) outside the KSU SELinux
	  domain; su/ksud and the manager app are exempt, and system processes
	  (init/vold/zygote) are untouched. openat(2), openat2(2),
	  newfstatat(2), faccessat(2), faccessat2(2), readlinkat(2) and
	  statx(2) return -ENOENT for /data/adb/ksu, /data/adb/modules,
	  /sys/module/kernelsu and the manager APK directory under /data/app.
	  The module is also detached from /proc/modules, which makes unloading
	  impossible for the rest of the boot. This does not hide the manager
	  package from PackageManager (userspace) and does not touch kallsyms.

config KSU_RESTRICTED_ROOT
	bool "Restrict KSU root: no block writes, no module load"
	depends on KSU
	default y
	help
	  Deny opening block devices for write, write/mmap(PROT_WRITE) on them,
	  and init_module()/finit_module(), ptrace, process_vm_writev,
	  pidfd_getfd, io_uring and kexec for the KSU domain and for any uid-0
	  task that lacks CAP_SYS_ADMIN/CAP_SYS_MODULE. That capability check
	  survives a setcon escape from the permissive KSU domain. init, vold
	  and update_engine keep both capabilities and are unaffected; the
	  loader shell is the trust root and is not restricted. ksud and KSU
	  module scripts are trusted and keep full credentials.

endmenu
```
